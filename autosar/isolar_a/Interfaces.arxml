AUTOSAR XML (schema 4-0-3)
package /Interfaces
  client server interface CS_ACT_TO_ECU
    operation OPER_ACT_TO_ECU
      arg ADP_ACT_TO_ECU: type=sint32, direction=INOUT
  client server interface CS_ECU_TO_SENSOR
    operation OPER_ECU_TO_SENSOR
      arg ADP_ECU_TO_SENSOR: type=sint32, direction=INOUT
  sender receiver interface SR_SENSOR_TO_APP
    data VDP_SENSOR_TO_APP: type=sint32
  sender receiver interface SR_APP_TO_ACT
    data VDP_APP_TO_ACT: type=sint32
