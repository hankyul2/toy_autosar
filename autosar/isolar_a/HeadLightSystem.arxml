AUTOSAR XML (schema 4-0-3)
package /HeadLightSystem
  system LightSystem: category=SYSTEM_EXTRACT
    system mapping SystemMapping_0
      sw-mappings:
        swc to ecu mapping SwcToEcuMapping_0: ecu-instance=EcuInstance_0
          component:
            RootSwCompositionPrototype_0.CPT_ACT_HIGHBEAM
            RootSwCompositionPrototype_0.CPT_ACT_LEFTRIGHT_MOTOR
            RootSwCompositionPrototype_0.CPT_ACT_LOWBEAM
            RootSwCompositionPrototype_0.CPT_ACT_UPDOWN_MOTOR
            RootSwCompositionPrototype_0.CPT_APP_HIGHBEAM
            RootSwCompositionPrototype_0.CPT_APP_LOWBEAM
            RootSwCompositionPrototype_0.CPT_APP_MOTOR
            RootSwCompositionPrototype_0.CPT_ECU_ABS_AFS
            RootSwCompositionPrototype_0.CPT_SENSOR_DISTANCE
            RootSwCompositionPrototype_0.CPT_SENSOR_LIGHT
            RootSwCompositionPrototype_0.CPT_SENSOR_LIGHTMODE
            RootSwCompositionPrototype_0.CPT_SENSOR_SPEED
            RootSwCompositionPrototype_0.CPT_SENSOR_STEERINGANGLE
    root-software-compositions:
      root sw composition prototype RootSwCompositionPrototype_0: software-composition=COMP_AFS
  ecu instance EcuInstance_0
