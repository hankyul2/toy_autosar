AUTOSAR XML (schema 4-0-2)
standard types defined: sint32, uint8
package /AUTOSAR_Rte/BswModuleDescriptions
  bsw module description RteBswModuleDescription: provided-entrys=[Rte_Start, Rte_Stop, SchM_DeInit, SchM_Init]
    bsw module dependency ModDepOS: target-module-id=001
      required-entrys:
        ActivateTask
        CancelAlarm
        ClearEvent
        GetEvent
        GetResource
        GetTaskID
        ReleaseResource
        ResumeOSInterrupts
        SetEvent
        SetRelAlarm
        SuspendOSInterrupts
        TerminateTask
        WaitEvent
    bsw internal behavior RteInternalBehavior
      constant-memorys:
        50 x parameter data prototype:
          Rte_Inst_ACT_HIGHBEAM: type=Rte_CDS_ACT_HIGHBEAM
          Rte_Inst_ACT_LEFTRIGHT_MOTOR: type=Rte_CDS_ACT_LEFTRIGHT_MOTOR
          Rte_Inst_ACT_LOWBEAM: type=Rte_CDS_ACT_LOWBEAM
          Rte_Inst_ACT_UPDOWN_MOTOR: type=Rte_CDS_ACT_UPDOWN_MOTOR
          Rte_Inst_APP_HIGHBEAM: type=Rte_CDS_APP_HIGHBEAM
          Rte_Inst_APP_LOWBEAM: type=Rte_CDS_APP_LOWBEAM
          Rte_Inst_APP_MOTOR: type=Rte_CDS_APP_MOTOR
          Rte_Inst_ECU_ABS_AFS: type=Rte_CDS_ECU_ABS_AFS
          Rte_Inst_SENSOR_DISTANCE: type=Rte_CDS_SENSOR_DISTANCE
          Rte_Inst_SENSOR_LIGHT: type=Rte_CDS_SENSOR_LIGHT
          Rte_Inst_SENSOR_LIGHTMODE: type=Rte_CDS_SENSOR_LIGHTMODE
          Rte_Inst_SENSOR_SPEED: type=Rte_CDS_SENSOR_SPEED
          Rte_Inst_SENSOR_STEERINGANGLE: type=Rte_CDS_SENSOR_STEERINGANGLE
          Rte_Queue_CPT_ACT_HIGHBEAM_P_HIGBEAMMODE_TO_ECU_ABS_AFS_OPER_ACT_TO_ECU: type=Rte_QTaskType
          Rte_Queue_CPT_ACT_LEFTRIGHT_MOTOR_P_LEFTRIGHTANGLE_TO_ECU_ABS_AFS_OPER_ACT_TO_ECU: type=Rte_QTaskType
          Rte_Queue_CPT_ACT_LOWBEAM_P_LOWBEAMMODE_TO_ECU_ABS_AFS_OPER_ACT_TO_ECU: type=Rte_QTaskType
          Rte_Queue_CPT_ACT_UPDOWN_MOTOR_P_UPDOWNANGLE_TO_ECU_ABS_AFS_OPER_ACT_TO_ECU: type=Rte_QTaskType
          Rte_Queue_CPT_ECU_ABS_AFS_P_DISTANCE_TO_SENSOR_DISTANCE_OPER_ECU_TO_SENSOR: type=Rte_QTaskType
          Rte_Queue_CPT_ECU_ABS_AFS_P_LIGHTMODE_TO_SENSOR_LIGHTMODE_OPER_ECU_TO_SENSOR: type=Rte_QTaskType
          Rte_Queue_CPT_ECU_ABS_AFS_P_LIGHT_TO_SENSOR_LIGHT_OPER_ECU_TO_SENSOR: type=Rte_QTaskType
          Rte_Queue_CPT_ECU_ABS_AFS_P_SPEED_TO_SENSOR_SPEED_OPER_ECU_TO_SENSOR: type=Rte_QTaskType
          Rte_Queue_CPT_ECU_ABS_AFS_P_STEERINGALGLE_TO_SENSOR_STERRINGANGLE_OPER_ECU_TO_SENSOR: type=Rte_QTaskType
          Rte_Queue_CPT_ECU_ABS_AFS_R_HIGHBEAMMODE_FROM_ACT_HIGHBEAM_OPER_ACT_TO_ECU: type=Rte_QWWPType
          Rte_Queue_CPT_ECU_ABS_AFS_R_HIGHBEAMMODE_FROM_ACT_HIGHBEAM_OPER_ACT_TO_ECU_wowp: type=Rte_WOWP_NotificationType
          Rte_Queue_CPT_ECU_ABS_AFS_R_LEFTRIGHTANGLE_FROM_ACT_LEFTRIGHT_MOTOR_OPER_ACT_TO_ECU: type=Rte_QWWPType
          Rte_Queue_CPT_ECU_ABS_AFS_R_LEFTRIGHTANGLE_FROM_ACT_LEFTRIGHT_MOTOR_OPER_ACT_TO_ECU_wowp: type=Rte_WOWP_NotificationType
          Rte_Queue_CPT_ECU_ABS_AFS_R_LOWBEAMMODE_FROM_ACT_LOWBEAM_OPER_ACT_TO_ECU: type=Rte_QWWPType
          Rte_Queue_CPT_ECU_ABS_AFS_R_LOWBEAMMODE_FROM_ACT_LOWBEAM_OPER_ACT_TO_ECU_wowp: type=Rte_WOWP_NotificationType
          Rte_Queue_CPT_ECU_ABS_AFS_R_UPDOWNANGLE_FROM_ACT_UPDOWN_MOTOR_OPER_ACT_TO_ECU: type=Rte_QWWPType
          Rte_Queue_CPT_ECU_ABS_AFS_R_UPDOWNANGLE_FROM_ACT_UPDOWN_MOTOR_OPER_ACT_TO_ECU_wowp: type=Rte_WOWP_NotificationType
          Rte_Queue_CPT_SENSOR_DISTANCE_R_DISTANCE_FROM_ECU_ABS_AFS_OPER_ECU_TO_SENSOR: type=Rte_QDRAType
          Rte_Queue_CPT_SENSOR_LIGHTMODE_R_LIGHTMODE_FROM_ECU_ABS_AFS_OPER_ECU_TO_SENSOR: type=Rte_QDRAType
          Rte_Queue_CPT_SENSOR_LIGHT_R_LIGHT_FROM_ECU_ABS_AFS_OPER_ECU_TO_SENSOR: type=Rte_QDRAType
          Rte_Queue_CPT_SENSOR_SPEED_R_SPEED_FROM_ECU_ABS_AFS_OPER_ECU_TO_SENSOR: type=Rte_QDRAType
          Rte_Queue_CPT_SENSOR_STEERINGANGLE_R_STEERINGANGLE_FROM_ECU_ABS_AFS_OPER_ECU_TO_SENSOR: type=Rte_QDRAType
          Rte_Self_CPT_ACT_HIGHBEAM: type=Rte_SelfType_ACT_HIGHBEAM
          Rte_Self_CPT_ACT_LEFTRIGHT_MOTOR: type=Rte_SelfType_ACT_LEFTRIGHT_MOTOR
          Rte_Self_CPT_ACT_LOWBEAM: type=Rte_SelfType_ACT_LOWBEAM
          Rte_Self_CPT_ACT_UPDOWN_MOTOR: type=Rte_SelfType_ACT_UPDOWN_MOTOR
          Rte_Self_CPT_APP_HIGHBEAM: type=Rte_SelfType_APP_HIGHBEAM
          Rte_Self_CPT_APP_LOWBEAM: type=Rte_SelfType_APP_LOWBEAM
          Rte_Self_CPT_APP_MOTOR: type=Rte_SelfType_APP_MOTOR
          Rte_Self_CPT_ECU_ABS_AFS: type=Rte_SelfType_ECU_ABS_AFS
          Rte_Self_CPT_SENSOR_DISTANCE: type=Rte_SelfType_SENSOR_DISTANCE
          Rte_Self_CPT_SENSOR_LIGHT: type=Rte_SelfType_SENSOR_LIGHT
          Rte_Self_CPT_SENSOR_LIGHTMODE: type=Rte_SelfType_SENSOR_LIGHTMODE
          Rte_Self_CPT_SENSOR_SPEED: type=Rte_SelfType_SENSOR_SPEED
          Rte_Self_CPT_SENSOR_STEERINGANGLE: type=Rte_SelfType_SENSOR_STEERINGANGLE
          Rte_Tasks: type=Rte_TaskInfo
          Rte_TimeoutAlarms: type=Rte_AlarmRefType
      static-memorys:
        74 x data:
          CPT_ACT_HIGHBEAM_IB_ACT_HIGHBEAM_Explicit_VariableDataPrototype_0: type=sint32
          CPT_ACT_LEFTRIGHT_MOTOR_IB_ACT_LEFTRIGHT_MOTOR_Explicit_VariableDataPrototype_0: type=sint32
          CPT_ACT_LOWBEAM_IB_ACT_LOWBEAM_Explicit_VariableDataPrototype_0: type=sint32
          CPT_ACT_UPDOWN_MOTOR_IB_ACT_UPDOWN_MOTOR_Explicit_VariableDataPrototype_0: type=sint32
          Rte_ActCount_CPT_ACT_HIGHBEAM_DRE_HIGHBEAM_RECEIVE: type=Rte_REActCounterType
          Rte_ActCount_CPT_ACT_LEFTRIGHT_MOTOR_DRE_LEFTRIGHTANGLE_RECEIVE: type=Rte_REActCounterType
          Rte_ActCount_CPT_ACT_LOWBEAM_DRE_LOWBEAM_RECEIVE: type=Rte_REActCounterType
          Rte_ActCount_CPT_ACT_UPDOWN_MOTOR_DRE_UPDOWNANGLE_RECEIVE: type=Rte_REActCounterType
          Rte_ActCount_CPT_APP_HIGHBEAM_DRE_DISTANCE: type=Rte_REActCounterType
          Rte_ActCount_CPT_APP_HIGHBEAM_DRE_LIGHTMODE: type=Rte_REActCounterType
          Rte_ActCount_CPT_APP_LOWBEAM_DRE_DISTANCE: type=Rte_REActCounterType
          Rte_ActCount_CPT_APP_LOWBEAM_DRE_LIGHT: type=Rte_REActCounterType
          Rte_ActCount_CPT_APP_LOWBEAM_DRE_LIGHTMODE: type=Rte_REActCounterType
          Rte_ActCount_CPT_APP_LOWBEAM_DRE_SPEED: type=Rte_REActCounterType
          Rte_ActCount_CPT_APP_MOTOR_DRE_SPEED: type=Rte_REActCounterType
          Rte_ActCount_CPT_APP_MOTOR_DRE_STEERING: type=Rte_REActCounterType
          Rte_Event_CPT_ECU_ABS_AFS_R_HIGHBEAMMODE_FROM_ACT_HIGHBEAM_OPER_ACT_TO_ECU_wd: type=Rte_WaitableDatum
          Rte_Event_CPT_ECU_ABS_AFS_R_LEFTRIGHTANGLE_FROM_ACT_LEFTRIGHT_MOTOR_OPER_ACT_TO_ECU_wd: type=Rte_WaitableDatum
          Rte_Event_CPT_ECU_ABS_AFS_R_LOWBEAMMODE_FROM_ACT_LOWBEAM_OPER_ACT_TO_ECU_wd: type=Rte_WaitableDatum
          Rte_Event_CPT_ECU_ABS_AFS_R_UPDOWNANGLE_FROM_ACT_UPDOWN_MOTOR_OPER_ACT_TO_ECU_wd: type=Rte_WaitableDatum
          Rte_Queue_CPT_ACT_HIGHBEAM_P_HIGBEAMMODE_TO_ECU_ABS_AFS_OPER_ACT_TO_ECU_data: type=Rte_CPT_ACT_HIGHBEAM_P_HIGBEAMMODE_TO_ECU_ABS_AFS_OPER_ACT_TO_ECU_QEType
          Rte_Queue_CPT_ACT_HIGHBEAM_P_HIGBEAMMODE_TO_ECU_ABS_AFS_OPER_ACT_TO_ECU_dyn: type=Rte_QDynType
          Rte_Queue_CPT_ACT_LEFTRIGHT_MOTOR_P_LEFTRIGHTANGLE_TO_ECU_ABS_AFS_OPER_ACT_TO_ECU_data: type=Rte_CPT_ACT_LEFTRIGHT_MOTOR_P_LEFTRIGHTANGLE_TO_ECU_ABS_AFS_OPER_ACT_TO_ECU_QEType
          Rte_Queue_CPT_ACT_LEFTRIGHT_MOTOR_P_LEFTRIGHTANGLE_TO_ECU_ABS_AFS_OPER_ACT_TO_ECU_dyn: type=Rte_QDynType
          Rte_Queue_CPT_ACT_LOWBEAM_P_LOWBEAMMODE_TO_ECU_ABS_AFS_OPER_ACT_TO_ECU_data: type=Rte_CPT_ACT_LOWBEAM_P_LOWBEAMMODE_TO_ECU_ABS_AFS_OPER_ACT_TO_ECU_QEType
          Rte_Queue_CPT_ACT_LOWBEAM_P_LOWBEAMMODE_TO_ECU_ABS_AFS_OPER_ACT_TO_ECU_dyn: type=Rte_QDynType
          Rte_Queue_CPT_ACT_UPDOWN_MOTOR_P_UPDOWNANGLE_TO_ECU_ABS_AFS_OPER_ACT_TO_ECU_data: type=Rte_CPT_ACT_UPDOWN_MOTOR_P_UPDOWNANGLE_TO_ECU_ABS_AFS_OPER_ACT_TO_ECU_QEType
          Rte_Queue_CPT_ACT_UPDOWN_MOTOR_P_UPDOWNANGLE_TO_ECU_ABS_AFS_OPER_ACT_TO_ECU_dyn: type=Rte_QDynType
          Rte_Queue_CPT_ECU_ABS_AFS_P_DISTANCE_TO_SENSOR_DISTANCE_OPER_ECU_TO_SENSOR_data: type=Rte_CPT_ECU_ABS_AFS_P_DISTANCE_TO_SENSOR_DISTANCE_OPER_ECU_TO_SENSOR_QEType
          Rte_Queue_CPT_ECU_ABS_AFS_P_DISTANCE_TO_SENSOR_DISTANCE_OPER_ECU_TO_SENSOR_dyn: type=Rte_QDynType
          Rte_Queue_CPT_ECU_ABS_AFS_P_LIGHTMODE_TO_SENSOR_LIGHTMODE_OPER_ECU_TO_SENSOR_data: type=Rte_CPT_ECU_ABS_AFS_P_LIGHTMODE_TO_SENSOR_LIGHTMODE_OPER_ECU_TO_SENSOR_QEType
          Rte_Queue_CPT_ECU_ABS_AFS_P_LIGHTMODE_TO_SENSOR_LIGHTMODE_OPER_ECU_TO_SENSOR_dyn: type=Rte_QDynType
          Rte_Queue_CPT_ECU_ABS_AFS_P_LIGHT_TO_SENSOR_LIGHT_OPER_ECU_TO_SENSOR_data: type=Rte_CPT_ECU_ABS_AFS_P_LIGHT_TO_SENSOR_LIGHT_OPER_ECU_TO_SENSOR_QEType
          Rte_Queue_CPT_ECU_ABS_AFS_P_LIGHT_TO_SENSOR_LIGHT_OPER_ECU_TO_SENSOR_dyn: type=Rte_QDynType
          Rte_Queue_CPT_ECU_ABS_AFS_P_SPEED_TO_SENSOR_SPEED_OPER_ECU_TO_SENSOR_data: type=Rte_CPT_ECU_ABS_AFS_P_SPEED_TO_SENSOR_SPEED_OPER_ECU_TO_SENSOR_QEType
          Rte_Queue_CPT_ECU_ABS_AFS_P_SPEED_TO_SENSOR_SPEED_OPER_ECU_TO_SENSOR_dyn: type=Rte_QDynType
          Rte_Queue_CPT_ECU_ABS_AFS_P_STEERINGALGLE_TO_SENSOR_STERRINGANGLE_OPER_ECU_TO_SENSOR_data: type=Rte_CPT_ECU_ABS_AFS_P_STEERINGALGLE_TO_SENSOR_STERRINGANGLE_OPER_ECU_TO_SENSOR_QEType
          Rte_Queue_CPT_ECU_ABS_AFS_P_STEERINGALGLE_TO_SENSOR_STERRINGANGLE_OPER_ECU_TO_SENSOR_dyn: type=Rte_QDynType
          Rte_Queue_CPT_ECU_ABS_AFS_R_HIGHBEAMMODE_FROM_ACT_HIGHBEAM_OPER_ACT_TO_ECU_data: type=Rte_CPT_ACT_HIGHBEAM_P_HIGBEAMMODE_TO_ECU_ABS_AFS_OPER_ACT_TO_ECU_RtnQEType
          Rte_Queue_CPT_ECU_ABS_AFS_R_HIGHBEAMMODE_FROM_ACT_HIGHBEAM_OPER_ACT_TO_ECU_dynamic: type=Rte_QDynType
          Rte_Queue_CPT_ECU_ABS_AFS_R_LEFTRIGHTANGLE_FROM_ACT_LEFTRIGHT_MOTOR_OPER_ACT_TO_ECU_data: type=Rte_CPT_ACT_LEFTRIGHT_MOTOR_P_LEFTRIGHTANGLE_TO_ECU_ABS_AFS_OPER_ACT_TO_ECU_RtnQEType
          Rte_Queue_CPT_ECU_ABS_AFS_R_LEFTRIGHTANGLE_FROM_ACT_LEFTRIGHT_MOTOR_OPER_ACT_TO_ECU_dynamic: type=Rte_QDynType
          Rte_Queue_CPT_ECU_ABS_AFS_R_LOWBEAMMODE_FROM_ACT_LOWBEAM_OPER_ACT_TO_ECU_data: type=Rte_CPT_ACT_LOWBEAM_P_LOWBEAMMODE_TO_ECU_ABS_AFS_OPER_ACT_TO_ECU_RtnQEType
          Rte_Queue_CPT_ECU_ABS_AFS_R_LOWBEAMMODE_FROM_ACT_LOWBEAM_OPER_ACT_TO_ECU_dynamic: type=Rte_QDynType
          Rte_Queue_CPT_ECU_ABS_AFS_R_UPDOWNANGLE_FROM_ACT_UPDOWN_MOTOR_OPER_ACT_TO_ECU_data: type=Rte_CPT_ACT_UPDOWN_MOTOR_P_UPDOWNANGLE_TO_ECU_ABS_AFS_OPER_ACT_TO_ECU_RtnQEType
          Rte_Queue_CPT_ECU_ABS_AFS_R_UPDOWNANGLE_FROM_ACT_UPDOWN_MOTOR_OPER_ACT_TO_ECU_dynamic: type=Rte_QDynType
          Rte_Queue_CPT_SENSOR_DISTANCE_R_DISTANCE_FROM_ECU_ABS_AFS_OPER_ECU_TO_SENSOR_data: type=Rte_CPT_ECU_ABS_AFS_P_DISTANCE_TO_SENSOR_DISTANCE_OPER_ECU_TO_SENSOR_RtnQEType
          Rte_Queue_CPT_SENSOR_DISTANCE_R_DISTANCE_FROM_ECU_ABS_AFS_OPER_ECU_TO_SENSOR_dynamic: type=Rte_QDynType
          Rte_Queue_CPT_SENSOR_LIGHTMODE_R_LIGHTMODE_FROM_ECU_ABS_AFS_OPER_ECU_TO_SENSOR_data: type=Rte_CPT_ECU_ABS_AFS_P_LIGHTMODE_TO_SENSOR_LIGHTMODE_OPER_ECU_TO_SENSOR_RtnQEType
          Rte_Queue_CPT_SENSOR_LIGHTMODE_R_LIGHTMODE_FROM_ECU_ABS_AFS_OPER_ECU_TO_SENSOR_dynamic: type=Rte_QDynType
          Rte_Queue_CPT_SENSOR_LIGHT_R_LIGHT_FROM_ECU_ABS_AFS_OPER_ECU_TO_SENSOR_data: type=Rte_CPT_ECU_ABS_AFS_P_LIGHT_TO_SENSOR_LIGHT_OPER_ECU_TO_SENSOR_RtnQEType
          Rte_Queue_CPT_SENSOR_LIGHT_R_LIGHT_FROM_ECU_ABS_AFS_OPER_ECU_TO_SENSOR_dynamic: type=Rte_QDynType
          Rte_Queue_CPT_SENSOR_SPEED_R_SPEED_FROM_ECU_ABS_AFS_OPER_ECU_TO_SENSOR_data: type=Rte_CPT_ECU_ABS_AFS_P_SPEED_TO_SENSOR_SPEED_OPER_ECU_TO_SENSOR_RtnQEType
          Rte_Queue_CPT_SENSOR_SPEED_R_SPEED_FROM_ECU_ABS_AFS_OPER_ECU_TO_SENSOR_dynamic: type=Rte_QDynType
          Rte_Queue_CPT_SENSOR_STEERINGANGLE_R_STEERINGANGLE_FROM_ECU_ABS_AFS_OPER_ECU_TO_SENSOR_data: type=Rte_CPT_ECU_ABS_AFS_P_STEERINGALGLE_TO_SENSOR_STERRINGANGLE_OPER_ECU_TO_SENSOR_RtnQEType
          Rte_Queue_CPT_SENSOR_STEERINGANGLE_R_STEERINGANGLE_FROM_ECU_ABS_AFS_OPER_ECU_TO_SENSOR_dynamic: type=Rte_QDynType
          Rte_Var_CPT_SENSOR_DISTANCE_R_DISTANCE_FROM_ECU_ABS_AFS_OPER_ECU_TO_SENSOR_outstanding: type=uint8
          Rte_Var_CPT_SENSOR_LIGHTMODE_R_LIGHTMODE_FROM_ECU_ABS_AFS_OPER_ECU_TO_SENSOR_outstanding: type=uint8
          Rte_Var_CPT_SENSOR_LIGHT_R_LIGHT_FROM_ECU_ABS_AFS_OPER_ECU_TO_SENSOR_outstanding: type=uint8
          Rte_Var_CPT_SENSOR_SPEED_R_SPEED_FROM_ECU_ABS_AFS_OPER_ECU_TO_SENSOR_outstanding: type=uint8
          Rte_Var_CPT_SENSOR_STEERINGANGLE_R_STEERINGANGLE_FROM_ECU_ABS_AFS_OPER_ECU_TO_SENSOR_outstanding: type=uint8
          Rte_Var_TASK_ECU_ACTUATORWaitingEv: type=Rte_EventType
          VDP_APP_TO_ACT: type=sint32
          VDP_APP_TO_ACT_{0..2}: type=sint32
          VDP_SENSOR_TO_APP: type=sint32
          VDP_SENSOR_TO_APP_{0..6}: type=sint32
      4 x bsw called entity:
        BCERte_Start: implemented-entry=Rte_Start
        BCERte_Stop: implemented-entry=Rte_Stop
        BCESchM_DeInit: implemented-entry=SchM_DeInit
        BCESchM_Init: implemented-entry=SchM_Init
package /AUTOSAR_Rte/BswModuleEntrys
  4 x bsw module entry:
    Rte_Start
    Rte_Stop
    SchM_DeInit
    SchM_Init
package /AUTOSAR_Rte/BswImplementations
  bsw implementation Rte: programming-language=C, sw-version=0.0.0, used-code-generator=ETAS RTEGen, ar-release-version=4.0.0, behavior=RteInternalBehavior
    generated-artifacts:
      112 x dependency on artifact:
        ACT_HIGHBEAM_MemMap_h: artifact-descriptor={short-label=ACT_HIGHBEAM_MemMap_h, category=SWHDR, domain=AUTOSAR}
        ACT_LEFTRIGHT_MOTOR_MemMap_h: artifact-descriptor={short-label=ACT_LEFTRIGHT_MOTOR_MemMap_h, category=SWHDR, domain=AUTOSAR}
        ACT_LOWBEAM_MemMap_h: artifact-descriptor={short-label=ACT_LOWBEAM_MemMap_h, category=SWHDR, domain=AUTOSAR}
        ACT_UPDOWN_MOTOR_MemMap_h: artifact-descriptor={short-label=ACT_UPDOWN_MOTOR_MemMap_h, category=SWHDR, domain=AUTOSAR}
        APP_HIGHBEAM_MemMap_h: artifact-descriptor={short-label=APP_HIGHBEAM_MemMap_h, category=SWHDR, domain=AUTOSAR}
        APP_LOWBEAM_MemMap_h: artifact-descriptor={short-label=APP_LOWBEAM_MemMap_h, category=SWHDR, domain=AUTOSAR}
        APP_MOTOR_MemMap_h: artifact-descriptor={short-label=APP_MOTOR_MemMap_h, category=SWHDR, domain=AUTOSAR}
        Com_h: artifact-descriptor={short-label=Com_h, category=SWHDR, domain=AUTOSAR}
        ECU_ABS_AFS_MemMap_h: artifact-descriptor={short-label=ECU_ABS_AFS_MemMap_h, category=SWHDR, domain=AUTOSAR}
        Ioc_h: artifact-descriptor={short-label=Ioc_h, category=SWHDR, domain=AUTOSAR}
        MemMap_h: artifact-descriptor={short-label=MemMap_h, category=SWHDR, domain=AUTOSAR}
        NvM_h: artifact-descriptor={short-label=NvM_h, category=SWHDR, domain=AUTOSAR}
        Os_h: artifact-descriptor={short-label=Os_h, category=SWHDR, domain=AUTOSAR}
        Rte_c: artifact-descriptor={short-label=Rte_c, category=SWSRC, domain=AUTOSAR}
        Rte_h: artifact-descriptor={short-label=Rte_h, category=SWHDR, domain=AUTOSAR}
        Rte_ACT_HIGHBEAM_c: artifact-descriptor={short-label=Rte_ACT_HIGHBEAM_c, category=SWSRC, domain=AUTOSAR}
        Rte_ACT_HIGHBEAM_h: artifact-descriptor={short-label=Rte_ACT_HIGHBEAM_h, category=SWHDR, domain=AUTOSAR}
        Rte_ACT_HIGHBEAM_Type_h: artifact-descriptor={short-label=Rte_ACT_HIGHBEAM_Type_h, category=SWHDR, domain=AUTOSAR}
        Rte_ACT_LEFTRIGHT_MOTOR_c: artifact-descriptor={short-label=Rte_ACT_LEFTRIGHT_MOTOR_c, category=SWSRC, domain=AUTOSAR}
        Rte_ACT_LEFTRIGHT_MOTOR_h: artifact-descriptor={short-label=Rte_ACT_LEFTRIGHT_MOTOR_h, category=SWHDR, domain=AUTOSAR}
        Rte_ACT_LEFTRIGHT_MOTOR_Type_h: artifact-descriptor={short-label=Rte_ACT_LEFTRIGHT_MOTOR_Type_h, category=SWHDR, domain=AUTOSAR}
        Rte_ACT_LOWBEAM_c: artifact-descriptor={short-label=Rte_ACT_LOWBEAM_c, category=SWSRC, domain=AUTOSAR}
        Rte_ACT_LOWBEAM_h: artifact-descriptor={short-label=Rte_ACT_LOWBEAM_h, category=SWHDR, domain=AUTOSAR}
        Rte_ACT_LOWBEAM_Type_h: artifact-descriptor={short-label=Rte_ACT_LOWBEAM_Type_h, category=SWHDR, domain=AUTOSAR}
        Rte_ACT_UPDOWN_MOTOR_c: artifact-descriptor={short-label=Rte_ACT_UPDOWN_MOTOR_c, category=SWSRC, domain=AUTOSAR}
        Rte_ACT_UPDOWN_MOTOR_h: artifact-descriptor={short-label=Rte_ACT_UPDOWN_MOTOR_h, category=SWHDR, domain=AUTOSAR}
        Rte_ACT_UPDOWN_MOTOR_Type_h: artifact-descriptor={short-label=Rte_ACT_UPDOWN_MOTOR_Type_h, category=SWHDR, domain=AUTOSAR}
        Rte_APP_HIGHBEAM_c: artifact-descriptor={short-label=Rte_APP_HIGHBEAM_c, category=SWSRC, domain=AUTOSAR}
        Rte_APP_HIGHBEAM_h: artifact-descriptor={short-label=Rte_APP_HIGHBEAM_h, category=SWHDR, domain=AUTOSAR}
        Rte_APP_HIGHBEAM_Type_h: artifact-descriptor={short-label=Rte_APP_HIGHBEAM_Type_h, category=SWHDR, domain=AUTOSAR}
        Rte_APP_LOWBEAM_c: artifact-descriptor={short-label=Rte_APP_LOWBEAM_c, category=SWSRC, domain=AUTOSAR}
        Rte_APP_LOWBEAM_h: artifact-descriptor={short-label=Rte_APP_LOWBEAM_h, category=SWHDR, domain=AUTOSAR}
        Rte_APP_LOWBEAM_Type_h: artifact-descriptor={short-label=Rte_APP_LOWBEAM_Type_h, category=SWHDR, domain=AUTOSAR}
        Rte_APP_MOTOR_c: artifact-descriptor={short-label=Rte_APP_MOTOR_c, category=SWSRC, domain=AUTOSAR}
        Rte_APP_MOTOR_h: artifact-descriptor={short-label=Rte_APP_MOTOR_h, category=SWHDR, domain=AUTOSAR}
        Rte_APP_MOTOR_Type_h: artifact-descriptor={short-label=Rte_APP_MOTOR_Type_h, category=SWHDR, domain=AUTOSAR}
        Rte_Cbk_h: artifact-descriptor={short-label=Rte_Cbk_h, category=SWHDR, domain=AUTOSAR}
        Rte_Cfg_h: artifact-descriptor={short-label=Rte_Cfg_h, category=SWHDR, domain=AUTOSAR}
        Rte_Const_h: artifact-descriptor={short-label=Rte_Const_h, category=SWHDR, domain=AUTOSAR}
        Rte_DataHandleType_h: artifact-descriptor={short-label=Rte_DataHandleType_h, category=SWHDR, domain=AUTOSAR}
        Rte_ECU_ABS_AFS_c: artifact-descriptor={short-label=Rte_ECU_ABS_AFS_c, category=SWSRC, domain=AUTOSAR}
        Rte_ECU_ABS_AFS_h: artifact-descriptor={short-label=Rte_ECU_ABS_AFS_h, category=SWHDR, domain=AUTOSAR}
        Rte_ECU_ABS_AFS_Type_h: artifact-descriptor={short-label=Rte_ECU_ABS_AFS_Type_h, category=SWHDR, domain=AUTOSAR}
        Rte_Hook_h: artifact-descriptor={short-label=Rte_Hook_h, category=SWHDR, domain=AUTOSAR}
        Rte_Intl_h: artifact-descriptor={short-label=Rte_Intl_h, category=SWHDR, domain=AUTOSAR}
        Rte_Lib_c: artifact-descriptor={short-label=Rte_Lib_c, category=SWSRC, domain=AUTOSAR}
        Rte_Main_h: artifact-descriptor={short-label=Rte_Main_h, category=SWHDR, domain=AUTOSAR}
        Rte_SENSOR_DISTANCE_c: artifact-descriptor={short-label=Rte_SENSOR_DISTANCE_c, category=SWSRC, domain=AUTOSAR}
        Rte_SENSOR_DISTANCE_h: artifact-descriptor={short-label=Rte_SENSOR_DISTANCE_h, category=SWHDR, domain=AUTOSAR}
        Rte_SENSOR_DISTANCE_Type_h: artifact-descriptor={short-label=Rte_SENSOR_DISTANCE_Type_h, category=SWHDR, domain=AUTOSAR}
        Rte_SENSOR_LIGHT_c: artifact-descriptor={short-label=Rte_SENSOR_LIGHT_c, category=SWSRC, domain=AUTOSAR}
        Rte_SENSOR_LIGHT_h: artifact-descriptor={short-label=Rte_SENSOR_LIGHT_h, category=SWHDR, domain=AUTOSAR}
        Rte_SENSOR_LIGHTMODE_c: artifact-descriptor={short-label=Rte_SENSOR_LIGHTMODE_c, category=SWSRC, domain=AUTOSAR}
        Rte_SENSOR_LIGHTMODE_h: artifact-descriptor={short-label=Rte_SENSOR_LIGHTMODE_h, category=SWHDR, domain=AUTOSAR}
        Rte_SENSOR_LIGHTMODE_Type_h: artifact-descriptor={short-label=Rte_SENSOR_LIGHTMODE_Type_h, category=SWHDR, domain=AUTOSAR}
        Rte_SENSOR_LIGHT_Type_h: artifact-descriptor={short-label=Rte_SENSOR_LIGHT_Type_h, category=SWHDR, domain=AUTOSAR}
        Rte_SENSOR_SPEED_c: artifact-descriptor={short-label=Rte_SENSOR_SPEED_c, category=SWSRC, domain=AUTOSAR}
        Rte_SENSOR_SPEED_h: artifact-descriptor={short-label=Rte_SENSOR_SPEED_h, category=SWHDR, domain=AUTOSAR}
        Rte_SENSOR_SPEED_Type_h: artifact-descriptor={short-label=Rte_SENSOR_SPEED_Type_h, category=SWHDR, domain=AUTOSAR}
        Rte_SENSOR_STEERINGANGLE_c: artifact-descriptor={short-label=Rte_SENSOR_STEERINGANGLE_c, category=SWSRC, domain=AUTOSAR}
        Rte_SENSOR_STEERINGANGLE_h: artifact-descriptor={short-label=Rte_SENSOR_STEERINGANGLE_h, category=SWHDR, domain=AUTOSAR}
        Rte_SENSOR_STEERINGANGLE_Type_h: artifact-descriptor={short-label=Rte_SENSOR_STEERINGANGLE_Type_h, category=SWHDR, domain=AUTOSAR}
        Rte_Type_h: artifact-descriptor={short-label=Rte_Type_h, category=SWHDR, domain=AUTOSAR}
        SENSOR_DISTANCE_MemMap_h: artifact-descriptor={short-label=SENSOR_DISTANCE_MemMap_h, category=SWHDR, domain=AUTOSAR}
        SENSOR_LIGHTMODE_MemMap_h: artifact-descriptor={short-label=SENSOR_LIGHTMODE_MemMap_h, category=SWHDR, domain=AUTOSAR}
        SENSOR_LIGHT_MemMap_h: artifact-descriptor={short-label=SENSOR_LIGHT_MemMap_h, category=SWHDR, domain=AUTOSAR}
        SENSOR_SPEED_MemMap_h: artifact-descriptor={short-label=SENSOR_SPEED_MemMap_h, category=SWHDR, domain=AUTOSAR}
        SENSOR_STEERINGANGLE_MemMap_h: artifact-descriptor={short-label=SENSOR_STEERINGANGLE_MemMap_h, category=SWHDR, domain=AUTOSAR}
        TAKS_ECU_SPEED_c: artifact-descriptor={short-label=TAKS_ECU_SPEED_c, category=SWSRC, domain=AUTOSAR}
        TAKS_ECU_SPEED_h: artifact-descriptor={short-label=TAKS_ECU_SPEED_h, category=SWHDR, domain=AUTOSAR}
        TASK_ACT_HIGHBEAM_RECEIVE_c: artifact-descriptor={short-label=TASK_ACT_HIGHBEAM_RECEIVE_c, category=SWSRC, domain=AUTOSAR}
        TASK_ACT_HIGHBEAM_RECEIVE_h: artifact-descriptor={short-label=TASK_ACT_HIGHBEAM_RECEIVE_h, category=SWHDR, domain=AUTOSAR}
        TASK_ACT_HIGHBEAM_SEND_c: artifact-descriptor={short-label=TASK_ACT_HIGHBEAM_SEND_c, category=SWSRC, domain=AUTOSAR}
        TASK_ACT_HIGHBEAM_SEND_h: artifact-descriptor={short-label=TASK_ACT_HIGHBEAM_SEND_h, category=SWHDR, domain=AUTOSAR}
        TASK_ACT_LEFTRIGHTANGLE_RECEIVE_c: artifact-descriptor={short-label=TASK_ACT_LEFTRIGHTANGLE_RECEIVE_c, category=SWSRC, domain=AUTOSAR}
        TASK_ACT_LEFTRIGHTANGLE_RECEIVE_h: artifact-descriptor={short-label=TASK_ACT_LEFTRIGHTANGLE_RECEIVE_h, category=SWHDR, domain=AUTOSAR}
        TASK_ACT_LEFTRIGHTANGLE_SEND_c: artifact-descriptor={short-label=TASK_ACT_LEFTRIGHTANGLE_SEND_c, category=SWSRC, domain=AUTOSAR}
        TASK_ACT_LEFTRIGHTANGLE_SEND_h: artifact-descriptor={short-label=TASK_ACT_LEFTRIGHTANGLE_SEND_h, category=SWHDR, domain=AUTOSAR}
        TASK_ACT_LOWBEAM_RECEIVE_c: artifact-descriptor={short-label=TASK_ACT_LOWBEAM_RECEIVE_c, category=SWSRC, domain=AUTOSAR}
        TASK_ACT_LOWBEAM_RECEIVE_h: artifact-descriptor={short-label=TASK_ACT_LOWBEAM_RECEIVE_h, category=SWHDR, domain=AUTOSAR}
        TASK_ACT_LOWBEAM_SEND_c: artifact-descriptor={short-label=TASK_ACT_LOWBEAM_SEND_c, category=SWSRC, domain=AUTOSAR}
        TASK_ACT_LOWBEAM_SEND_h: artifact-descriptor={short-label=TASK_ACT_LOWBEAM_SEND_h, category=SWHDR, domain=AUTOSAR}
        TASK_ACT_UPDOWNANGLE_RECEIVE_c: artifact-descriptor={short-label=TASK_ACT_UPDOWNANGLE_RECEIVE_c, category=SWSRC, domain=AUTOSAR}
        TASK_ACT_UPDOWNANGLE_RECEIVE_h: artifact-descriptor={short-label=TASK_ACT_UPDOWNANGLE_RECEIVE_h, category=SWHDR, domain=AUTOSAR}
        TASK_ACT_UPDOWNANGLE_SEND_c: artifact-descriptor={short-label=TASK_ACT_UPDOWNANGLE_SEND_c, category=SWSRC, domain=AUTOSAR}
        TASK_ACT_UPDOWNANGLE_SEND_h: artifact-descriptor={short-label=TASK_ACT_UPDOWNANGLE_SEND_h, category=SWHDR, domain=AUTOSAR}
        TASK_APP_HIGHBEAM_c: artifact-descriptor={short-label=TASK_APP_HIGHBEAM_c, category=SWSRC, domain=AUTOSAR}
        TASK_APP_HIGHBEAM_h: artifact-descriptor={short-label=TASK_APP_HIGHBEAM_h, category=SWHDR, domain=AUTOSAR}
        TASK_APP_LOWBEAM_c: artifact-descriptor={short-label=TASK_APP_LOWBEAM_c, category=SWSRC, domain=AUTOSAR}
        TASK_APP_LOWBEAM_h: artifact-descriptor={short-label=TASK_APP_LOWBEAM_h, category=SWHDR, domain=AUTOSAR}
        TASK_APP_MOTOR_c: artifact-descriptor={short-label=TASK_APP_MOTOR_c, category=SWSRC, domain=AUTOSAR}
        TASK_APP_MOTOR_h: artifact-descriptor={short-label=TASK_APP_MOTOR_h, category=SWHDR, domain=AUTOSAR}
        TASK_ECU_ACTUATOR_c: artifact-descriptor={short-label=TASK_ECU_ACTUATOR_c, category=SWSRC, domain=AUTOSAR}
        TASK_ECU_ACTUATOR_h: artifact-descriptor={short-label=TASK_ECU_ACTUATOR_h, category=SWHDR, domain=AUTOSAR}
        TASK_ECU_DISTANCE_c: artifact-descriptor={short-label=TASK_ECU_DISTANCE_c, category=SWSRC, domain=AUTOSAR}
        TASK_ECU_DISTANCE_h: artifact-descriptor={short-label=TASK_ECU_DISTANCE_h, category=SWHDR, domain=AUTOSAR}
        TASK_ECU_LIGHT_c: artifact-descriptor={short-label=TASK_ECU_LIGHT_c, category=SWSRC, domain=AUTOSAR}
        TASK_ECU_LIGHT_h: artifact-descriptor={short-label=TASK_ECU_LIGHT_h, category=SWHDR, domain=AUTOSAR}
        TASK_ECU_LIGHTMODE_c: artifact-descriptor={short-label=TASK_ECU_LIGHTMODE_c, category=SWSRC, domain=AUTOSAR}
        TASK_ECU_LIGHTMODE_h: artifact-descriptor={short-label=TASK_ECU_LIGHTMODE_h, category=SWHDR, domain=AUTOSAR}
        TASK_EUC_STEERINGANGLE_c: artifact-descriptor={short-label=TASK_EUC_STEERINGANGLE_c, category=SWSRC, domain=AUTOSAR}
        TASK_EUC_STEERINGANGLE_h: artifact-descriptor={short-label=TASK_EUC_STEERINGANGLE_h, category=SWHDR, domain=AUTOSAR}
        TASK_SENSOR_DISTANCE_c: artifact-descriptor={short-label=TASK_SENSOR_DISTANCE_c, category=SWSRC, domain=AUTOSAR}
        TASK_SENSOR_DISTANCE_h: artifact-descriptor={short-label=TASK_SENSOR_DISTANCE_h, category=SWHDR, domain=AUTOSAR}
        TASK_SENSOR_LIGHT_c: artifact-descriptor={short-label=TASK_SENSOR_LIGHT_c, category=SWSRC, domain=AUTOSAR}
        TASK_SENSOR_LIGHT_h: artifact-descriptor={short-label=TASK_SENSOR_LIGHT_h, category=SWHDR, domain=AUTOSAR}
        TASK_SENSOR_LIGHTMODE_c: artifact-descriptor={short-label=TASK_SENSOR_LIGHTMODE_c, category=SWSRC, domain=AUTOSAR}
        TASK_SENSOR_LIGHTMODE_h: artifact-descriptor={short-label=TASK_SENSOR_LIGHTMODE_h, category=SWHDR, domain=AUTOSAR}
        TASK_SENSOR_SPEED_c: artifact-descriptor={short-label=TASK_SENSOR_SPEED_c, category=SWSRC, domain=AUTOSAR}
        TASK_SENSOR_SPEED_h: artifact-descriptor={short-label=TASK_SENSOR_SPEED_h, category=SWHDR, domain=AUTOSAR}
        TASK_SENSOR_STEERINGANGLE_c: artifact-descriptor={short-label=TASK_SENSOR_STEERINGANGLE_c, category=SWSRC, domain=AUTOSAR}
        TASK_SENSOR_STEERINGANGLE_h: artifact-descriptor={short-label=TASK_SENSOR_STEERINGANGLE_h, category=SWHDR, domain=AUTOSAR}
    resource consumption ResConsumption
      6 x memory section:
        CODE: alignment=UNSPECIFIED, sw-addrmethod=CODE
        CONST_UNSPECIFIED: alignment=UNSPECIFIED, sw-addrmethod=CONST_UNSPECIFIED
        TASKBODY: alignment=UNSPECIFIED, sw-addrmethod=TASKBODY
        VAR_32BIT: alignment=32, sw-addrmethod=VAR_32BIT
        VAR_8BIT: alignment=8, sw-addrmethod=VAR_8BIT
        VAR_UNSPECIFIED: alignment=UNSPECIFIED, sw-addrmethod=VAR_UNSPECIFIED
package /AUTOSAR_Rte/DataConstrs
  range DataConstraints_DataConstr_sint32: phys -2147483648..2147483647, raw -2147483648..2147483647
  range DataConstraints_DataConstr_uint8: phys 0..255, raw 0..255
package /AUTOSAR_Rte/ImplementationDataTypes
  55 x impl type:
    Rte_REActCounterType: category=VALUE  # This is an external type, i.e. it is declared in the Rte Library and not in the XML. RTEGen does not have any information about this type apart from its name.
    Rte_WaitableDatum: category=VALUE  # This is an external type, i.e. it is declared in the Rte Library and not in the XML. RTEGen does not have any information about this type apart from its name.
    Rte_CDS_ACT_HIGHBEAM: category=STRUCTURE
      element _dummy: implementation-data-type=uint8
    Rte_CDS_ACT_LEFTRIGHT_MOTOR: category=STRUCTURE
      element _dummy: implementation-data-type=uint8
    Rte_CDS_ACT_LOWBEAM: category=STRUCTURE
      element _dummy: implementation-data-type=uint8
    Rte_CDS_ACT_UPDOWN_MOTOR: category=STRUCTURE
      element _dummy: implementation-data-type=uint8
    Rte_CDS_APP_HIGHBEAM: category=STRUCTURE
      element _dummy: implementation-data-type=uint8
    Rte_CDS_APP_LOWBEAM: category=STRUCTURE
      element _dummy: implementation-data-type=uint8
    Rte_CDS_APP_MOTOR: category=STRUCTURE
      element _dummy: implementation-data-type=uint8
    Rte_CDS_ECU_ABS_AFS: category=STRUCTURE
      element _dummy: implementation-data-type=uint8
    Rte_CDS_SENSOR_DISTANCE: category=STRUCTURE
      element _dummy: implementation-data-type=uint8
    Rte_CDS_SENSOR_LIGHT: category=STRUCTURE
      element _dummy: implementation-data-type=uint8
    Rte_CDS_SENSOR_LIGHTMODE: category=STRUCTURE
      element _dummy: implementation-data-type=uint8
    Rte_CDS_SENSOR_SPEED: category=STRUCTURE
      element _dummy: implementation-data-type=uint8
    Rte_CDS_SENSOR_STEERINGANGLE: category=STRUCTURE
      element _dummy: implementation-data-type=uint8
    Rte_QTaskType: category=VALUE  # This is an external type, i.e. it is declared in the Rte Library and not in the XML. RTEGen does not have any information about this type apart from its name.
    Rte_QCmnRefType: category=VALUE  # This is an external type, i.e. it is declared in the Rte Library and not in the XML. RTEGen does not have any information about this type apart from its name.
    Rte_CPT_ACT_HIGHBEAM_P_HIGBEAMMODE_TO_ECU_ABS_AFS_OPER_ACT_TO_ECU_QEType: category=STRUCTURE
      element ADP_ACT_TO_ECU: implementation-data-type=sint32
      element clientQueue: implementation-data-type=Rte_QCmnRefType
    Rte_QDynType: category=VALUE  # This is an external type, i.e. it is declared in the Rte Library and not in the XML. RTEGen does not have any information about this type apart from its name.
    Rte_CPT_ACT_LEFTRIGHT_MOTOR_P_LEFTRIGHTANGLE_TO_ECU_ABS_AFS_OPER_ACT_TO_ECU_QEType: category=STRUCTURE
      element ADP_ACT_TO_ECU: implementation-data-type=sint32
      element clientQueue: implementation-data-type=Rte_QCmnRefType
    Rte_CPT_ACT_LOWBEAM_P_LOWBEAMMODE_TO_ECU_ABS_AFS_OPER_ACT_TO_ECU_QEType: category=STRUCTURE
      element ADP_ACT_TO_ECU: implementation-data-type=sint32
      element clientQueue: implementation-data-type=Rte_QCmnRefType
    Rte_CPT_ACT_UPDOWN_MOTOR_P_UPDOWNANGLE_TO_ECU_ABS_AFS_OPER_ACT_TO_ECU_QEType: category=STRUCTURE
      element ADP_ACT_TO_ECU: implementation-data-type=sint32
      element clientQueue: implementation-data-type=Rte_QCmnRefType
    Rte_CPT_ECU_ABS_AFS_P_DISTANCE_TO_SENSOR_DISTANCE_OPER_ECU_TO_SENSOR_QEType: category=STRUCTURE
      element ADP_ECU_TO_SENSOR: implementation-data-type=sint32
      element clientQueue: implementation-data-type=Rte_QCmnRefType
    Rte_CPT_ECU_ABS_AFS_P_LIGHTMODE_TO_SENSOR_LIGHTMODE_OPER_ECU_TO_SENSOR_QEType: category=STRUCTURE
      element ADP_ECU_TO_SENSOR: implementation-data-type=sint32
      element clientQueue: implementation-data-type=Rte_QCmnRefType
    Rte_CPT_ECU_ABS_AFS_P_LIGHT_TO_SENSOR_LIGHT_OPER_ECU_TO_SENSOR_QEType: category=STRUCTURE
      element ADP_ECU_TO_SENSOR: implementation-data-type=sint32
      element clientQueue: implementation-data-type=Rte_QCmnRefType
    Rte_CPT_ECU_ABS_AFS_P_SPEED_TO_SENSOR_SPEED_OPER_ECU_TO_SENSOR_QEType: category=STRUCTURE
      element ADP_ECU_TO_SENSOR: implementation-data-type=sint32
      element clientQueue: implementation-data-type=Rte_QCmnRefType
    Rte_CPT_ECU_ABS_AFS_P_STEERINGALGLE_TO_SENSOR_STERRINGANGLE_OPER_ECU_TO_SENSOR_QEType: category=STRUCTURE
      element ADP_ECU_TO_SENSOR: implementation-data-type=sint32
      element clientQueue: implementation-data-type=Rte_QCmnRefType
    Rte_QWWPType: category=VALUE  # This is an external type, i.e. it is declared in the Rte Library and not in the XML. RTEGen does not have any information about this type apart from its name.
    Rte_CPT_ACT_HIGHBEAM_P_HIGBEAMMODE_TO_ECU_ABS_AFS_OPER_ACT_TO_ECU_RtnQEType: category=STRUCTURE
      element ADP_ACT_TO_ECU: implementation-data-type=sint32
    Rte_WOWP_NotificationType: category=VALUE  # This is an external type, i.e. it is declared in the Rte Library and not in the XML. RTEGen does not have any information about this type apart from its name.
    Rte_CPT_ACT_LEFTRIGHT_MOTOR_P_LEFTRIGHTANGLE_TO_ECU_ABS_AFS_OPER_ACT_TO_ECU_RtnQEType: category=STRUCTURE
      element ADP_ACT_TO_ECU: implementation-data-type=sint32
    Rte_CPT_ACT_LOWBEAM_P_LOWBEAMMODE_TO_ECU_ABS_AFS_OPER_ACT_TO_ECU_RtnQEType: category=STRUCTURE
      element ADP_ACT_TO_ECU: implementation-data-type=sint32
    Rte_CPT_ACT_UPDOWN_MOTOR_P_UPDOWNANGLE_TO_ECU_ABS_AFS_OPER_ACT_TO_ECU_RtnQEType: category=STRUCTURE
      element ADP_ACT_TO_ECU: implementation-data-type=sint32
    Rte_QDRAType: category=VALUE  # This is an external type, i.e. it is declared in the Rte Library and not in the XML. RTEGen does not have any information about this type apart from its name.
    Rte_CPT_ECU_ABS_AFS_P_DISTANCE_TO_SENSOR_DISTANCE_OPER_ECU_TO_SENSOR_RtnQEType: category=STRUCTURE
      element ADP_ECU_TO_SENSOR: implementation-data-type=sint32
    Rte_CPT_ECU_ABS_AFS_P_LIGHTMODE_TO_SENSOR_LIGHTMODE_OPER_ECU_TO_SENSOR_RtnQEType: category=STRUCTURE
      element ADP_ECU_TO_SENSOR: implementation-data-type=sint32
    Rte_CPT_ECU_ABS_AFS_P_LIGHT_TO_SENSOR_LIGHT_OPER_ECU_TO_SENSOR_RtnQEType: category=STRUCTURE
      element ADP_ECU_TO_SENSOR: implementation-data-type=sint32
    Rte_CPT_ECU_ABS_AFS_P_SPEED_TO_SENSOR_SPEED_OPER_ECU_TO_SENSOR_RtnQEType: category=STRUCTURE
      element ADP_ECU_TO_SENSOR: implementation-data-type=sint32
    Rte_CPT_ECU_ABS_AFS_P_STEERINGALGLE_TO_SENSOR_STERRINGANGLE_OPER_ECU_TO_SENSOR_RtnQEType: category=STRUCTURE
      element ADP_ECU_TO_SENSOR: implementation-data-type=sint32
    Rte_SelfType_ACT_HIGHBEAM: implementation-data-type=Rte_CDS_ACT_HIGHBEAM
    Rte_SelfType_ACT_LEFTRIGHT_MOTOR: implementation-data-type=Rte_CDS_ACT_LEFTRIGHT_MOTOR
    Rte_SelfType_ACT_LOWBEAM: implementation-data-type=Rte_CDS_ACT_LOWBEAM
    Rte_SelfType_ACT_UPDOWN_MOTOR: implementation-data-type=Rte_CDS_ACT_UPDOWN_MOTOR
    Rte_SelfType_APP_HIGHBEAM: implementation-data-type=Rte_CDS_APP_HIGHBEAM
    Rte_SelfType_APP_LOWBEAM: implementation-data-type=Rte_CDS_APP_LOWBEAM
    Rte_SelfType_APP_MOTOR: implementation-data-type=Rte_CDS_APP_MOTOR
    Rte_SelfType_ECU_ABS_AFS: implementation-data-type=Rte_CDS_ECU_ABS_AFS
    Rte_SelfType_SENSOR_DISTANCE: implementation-data-type=Rte_CDS_SENSOR_DISTANCE
    Rte_SelfType_SENSOR_LIGHT: implementation-data-type=Rte_CDS_SENSOR_LIGHT
    Rte_SelfType_SENSOR_LIGHTMODE: implementation-data-type=Rte_CDS_SENSOR_LIGHTMODE
    Rte_SelfType_SENSOR_SPEED: implementation-data-type=Rte_CDS_SENSOR_SPEED
    Rte_SelfType_SENSOR_STEERINGANGLE: implementation-data-type=Rte_CDS_SENSOR_STEERINGANGLE
    Rte_TaskInfo: category=VALUE  # This is an external type, i.e. it is declared in the Rte Library and not in the XML. RTEGen does not have any information about this type apart from its name.
    Rte_AlarmRefType: category=VALUE  # This is an external type, i.e. it is declared in the Rte Library and not in the XML. RTEGen does not have any information about this type apart from its name.
    Rte_EventType: category=VALUE  # This is an external type, i.e. it is declared in the Rte Library and not in the XML. RTEGen does not have any information about this type apart from its name.
package /AUTOSAR_Rte/SwAddrMethods
  6 x sw addr method:
    CODE: section-type=CODE
    CONST_UNSPECIFIED: section-type=CONST
    TASKBODY: section-type=CODE
    VAR_32BIT: section-type=VAR
    VAR_8BIT: section-type=VAR
    VAR_UNSPECIFIED: section-type=VAR
