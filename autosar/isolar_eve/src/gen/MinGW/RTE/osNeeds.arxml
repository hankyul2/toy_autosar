AUTOSAR XML (schema 4-0-3)
package /OS_CFG
  module config Os_0: definition=Os
    RTE_RESOURCE (OsResource): OsResourceProperty=STANDARD
    22 x OsTask, all with OsTaskSchedule=FULL, OsTaskResourceRef=RTE_RESOURCE:
      TAKS_ECU_SPEED: OsTaskActivation=2, OsTaskPriority=1
      TASK_ECU_ACTUATOR: OsTaskActivation=1, OsTaskPriority=1, OsTaskEventRef=Rte_Activity, OsTaskEventRef=Rte_Timeout, OsTaskEventRef=Rte_Ev_100000000_0
        Autostart (OsTaskAutostart): OsTaskAppModeRef=OSDEFAULTAPPMODE
      TASK_ECU_DISTANCE: OsTaskActivation=2, OsTaskPriority=1
      TASK_ECU_LIGHT: OsTaskActivation=2, OsTaskPriority=1
      TASK_ECU_LIGHTMODE: OsTaskActivation=2, OsTaskPriority=1
      TASK_EUC_STEERINGANGLE: OsTaskActivation=2, OsTaskPriority=1
      TASK_ACT_HIGHBEAM_RECEIVE: OsTaskActivation=2, OsTaskPriority=2
      TASK_ACT_HIGHBEAM_SEND: OsTaskActivation=2, OsTaskPriority=2
      TASK_ACT_LEFTRIGHTANGLE_RECEIVE: OsTaskActivation=2, OsTaskPriority=2
      TASK_ACT_LEFTRIGHTANGLE_SEND: OsTaskActivation=2, OsTaskPriority=2
      TASK_ACT_LOWBEAM_RECEIVE: OsTaskActivation=2, OsTaskPriority=2
      TASK_ACT_LOWBEAM_SEND: OsTaskActivation=2, OsTaskPriority=2
      TASK_ACT_UPDOWNANGLE_RECEIVE: OsTaskActivation=2, OsTaskPriority=2
      TASK_ACT_UPDOWNANGLE_SEND: OsTaskActivation=2, OsTaskPriority=2
      TASK_SENSOR_DISTANCE: OsTaskActivation=1, OsTaskPriority=2
      TASK_SENSOR_LIGHT: OsTaskActivation=1, OsTaskPriority=2
      TASK_SENSOR_LIGHTMODE: OsTaskActivation=1, OsTaskPriority=2
      TASK_SENSOR_SPEED: OsTaskActivation=1, OsTaskPriority=2
      TASK_SENSOR_STEERINGANGLE: OsTaskActivation=1, OsTaskPriority=2
      TASK_APP_HIGHBEAM: OsTaskActivation=2, OsTaskPriority=3
      TASK_APP_LOWBEAM: OsTaskActivation=2, OsTaskPriority=3
      TASK_APP_MOTOR: OsTaskActivation=2, OsTaskPriority=3
    3 x OsEvent:
      Rte_Activity: OsEventMask=1
      Rte_Timeout: OsEventMask=2
      Rte_Ev_100000000_0
    Rte_TickCounter (OsCounter): OsCounterMaxAllowedValue=65535, OsCounterMinCycle=1, OsCounterTicksPerBase=1, OsCounterType=SOFTWARE
    Rte_ScheduleTable (OsScheduleTable): OsScheduleTableRepeating=true, OsScheduleTableDuration=1, OsScheduleTableCounterRef=Rte_TickCounter
      rte_Stimulus_1 (OsScheduleTableExpiryPoint): OsScheduleTblExpPointOffset=0
        EventSetting1 (OsScheduleTableEventSetting): OsScheduleTableSetEventRef=Rte_Ev_100000000_0, OsScheduleTableSetEventTaskRef=TASK_ECU_ACTUATOR
        5 x OsScheduleTableTaskActivation:
          TaskActivation1: OsScheduleTableActivateTaskRef=TASK_SENSOR_DISTANCE
          TaskActivation2: OsScheduleTableActivateTaskRef=TASK_SENSOR_LIGHT
          TaskActivation3: OsScheduleTableActivateTaskRef=TASK_SENSOR_LIGHTMODE
          TaskActivation4: OsScheduleTableActivateTaskRef=TASK_SENSOR_SPEED
          TaskActivation5: OsScheduleTableActivateTaskRef=TASK_SENSOR_STEERINGANGLE
    Rte_TOutCounter (OsCounter): OsCounterMaxAllowedValue=65535, OsCounterMinCycle=1, OsCounterTicksPerBase=1, OsCounterType=SOFTWARE
    6 x OsAlarm, all with OsAlarmCounterRef=Rte_TOutCounter:
      Rte_TimeoutAlarm1
        Action (OsAlarmAction)
          Callback (OsAlarmCallback): OsAlarmCallbackName=Rte_NullAlarmCallback
      Rte_TimeoutAlarm2
        Action (OsAlarmAction)
          Callback (OsAlarmCallback): OsAlarmCallbackName=Rte_NullAlarmCallback
      Rte_TimeoutAlarm3
        Action (OsAlarmAction)
          Callback (OsAlarmCallback): OsAlarmCallbackName=Rte_NullAlarmCallback
      Rte_TimeoutAlarm4
        Action (OsAlarmAction)
          Callback (OsAlarmCallback): OsAlarmCallbackName=Rte_NullAlarmCallback
      Rte_TimeoutAlarm5
        Action (OsAlarmAction)
          Callback (OsAlarmCallback): OsAlarmCallbackName=Rte_NullAlarmCallback
      Rte_TimeoutAlarm6
        Action (OsAlarmAction)
          SetEvent (OsAlarmSetEvent): OsAlarmSetEventRef=Rte_Timeout, OsAlarmSetEventTaskRef=TASK_ECU_ACTUATOR
