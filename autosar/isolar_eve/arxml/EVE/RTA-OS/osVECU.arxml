AUTOSAR XML (schema 4-0-3)
package /OS_CFG
  module config Os_0: definition=Os
    OSDEFAULTAPPMODE (OsAppMode)
    RTE_RESOURCE (OsResource)
    OsInfo (OsOS):
      OsScalabilityClass = SC1
      OsStatus = STANDARD
      OsStackMonitoring = false
      OsUseGetServiceId = false
      OsUseParameterAccess = false
      OsUseResScheduler = true
      OsCyclesPerSecond = 1000000
      OsTicksPerSecond = 1000
      HooksContainer (OsHooks): OsStartupHook=true, OsShutdownHook=true, OsPreTaskHook=false, OsPostTaskHook=false, OsStackFaultHook=false, OsProtectionHook=false, OsErrorHook=false
      meter_execution (Param): Value=false
      no_timing_protection (Param): Value=false
    VECU_SystemClock_ISR (OsIsr): OsIsrCategory=CATEGORY_2, OsIsrPriority=5, OsIsrAddress=7
    OsRTATarget: OsRTATargetName=VRTA, OsRTATargetVersion=3.0.23, OsRTATargetVariant=MinGW
      3 x Param, all with Value=128:
        SpIDisp
        SpECC
        SpPreemption
    22 x OsTask, all with OsTaskStackAllocation=128, OsTaskWaitStack=128:
      TAKS_ECU_SPEED
      TASK_ACT_HIGHBEAM_RECEIVE
      TASK_ACT_LEFTRIGHTANGLE_RECEIVE
      TASK_ACT_HIGHBEAM_SEND
      TASK_ACT_LEFTRIGHTANGLE_SEND
      TASK_ACT_LOWBEAM_RECEIVE
      TASK_ACT_LOWBEAM_SEND
      TASK_ACT_UPDOWNANGLE_RECEIVE
      TASK_ACT_UPDOWNANGLE_SEND
      TASK_APP_HIGHBEAM
      TASK_APP_LOWBEAM
      TASK_APP_MOTOR
      TASK_ECU_ACTUATOR
      TASK_ECU_DISTANCE
      TASK_ECU_LIGHT
      TASK_ECU_LIGHTMODE
      TASK_EUC_STEERINGANGLE
      TASK_SENSOR_DISTANCE
      TASK_SENSOR_LIGHT
      TASK_SENSOR_LIGHTMODE
      TASK_SENSOR_SPEED
      TASK_SENSOR_STEERINGANGLE
