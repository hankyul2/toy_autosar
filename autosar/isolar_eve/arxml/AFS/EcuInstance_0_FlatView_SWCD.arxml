AUTOSAR XML (schema 4-0-3)
package /EcuInstance_0_FlatView/SwComponentTypes
  composition sw component type EcuInstance_0_FlatView
    13 x component:
      CPT_ACT_HIGHBEAM: type=ACT_HIGHBEAM
      CPT_ACT_LEFTRIGHT_MOTOR: type=ACT_LEFTRIGHT_MOTOR
      CPT_ACT_LOWBEAM: type=ACT_LOWBEAM
      CPT_ACT_UPDOWN_MOTOR: type=ACT_UPDOWN_MOTOR
      CPT_APP_HIGHBEAM: type=APP_HIGHBEAM
      CPT_APP_LOWBEAM: type=APP_LOWBEAM
      CPT_APP_MOTOR: type=APP_MOTOR
      CPT_ECU_ABS_AFS: type=ECU_ABS_AFS
      CPT_SENSOR_DISTANCE: type=SENSOR_DISTANCE
      CPT_SENSOR_LIGHT: type=SENSOR_LIGHT
      CPT_SENSOR_LIGHTMODE: type=SENSOR_LIGHTMODE
      CPT_SENSOR_SPEED: type=SENSOR_SPEED
      CPT_SENSOR_STEERINGANGLE: type=SENSOR_STEERINGANGLE
    connect CPT_ACT_HIGHBEAM.P_HIGBEAMMODE_TO_ECU_ABS_AFS -> CPT_ECU_ABS_AFS.R_HIGHBEAMMODE_FROM_ACT_HIGHBEAM
    connect CPT_ACT_LEFTRIGHT_MOTOR.P_LEFTRIGHTANGLE_TO_ECU_ABS_AFS -> CPT_ECU_ABS_AFS.R_LEFTRIGHTANGLE_FROM_ACT_LEFTRIGHT_MOTOR
    connect CPT_ACT_LOWBEAM.P_LOWBEAMMODE_TO_ECU_ABS_AFS -> CPT_ECU_ABS_AFS.R_LOWBEAMMODE_FROM_ACT_LOWBEAM
    connect CPT_ACT_UPDOWN_MOTOR.P_UPDOWNANGLE_TO_ECU_ABS_AFS -> CPT_ECU_ABS_AFS.R_UPDOWNANGLE_FROM_ACT_UPDOWN_MOTOR
    connect CPT_APP_HIGHBEAM.P_HIGHBEAMMODE_TO_ACT_HIGHBEAM -> CPT_ACT_HIGHBEAM.R_HIGHBEAMMODE_FROM_APP_HIGHBEAM
    connect CPT_APP_LOWBEAM.P_LOWBEAMMODE_TO_ACT_LOWBEAM -> CPT_ACT_LOWBEAM.R_LOWBEAMMODE_FROM_APP_LOWBEAM
    connect CPT_APP_MOTOR.P_LEFTRIGHTANGLE_TO_ACT_LEFTRIGHT_MOTOR -> CPT_ACT_LEFTRIGHT_MOTOR.R_LEFTRIGHTANGLE_FROM_APP_MOTOR
    connect CPT_APP_MOTOR.P_UPDOWNANGLE_TO_ACT_UPDOWN_MOTOR -> CPT_ACT_UPDOWN_MOTOR.R_UPDOWNANGLE_FROM_APP_MOTOR
    connect CPT_ECU_ABS_AFS.P_DISTANCE_TO_SENSOR_DISTANCE -> CPT_SENSOR_DISTANCE.R_DISTANCE_FROM_ECU_ABS_AFS
    connect CPT_ECU_ABS_AFS.P_LIGHT_TO_SENSOR_LIGHT -> CPT_SENSOR_LIGHT.R_LIGHT_FROM_ECU_ABS_AFS
    connect CPT_ECU_ABS_AFS.P_LIGHTMODE_TO_SENSOR_LIGHTMODE -> CPT_SENSOR_LIGHTMODE.R_LIGHTMODE_FROM_ECU_ABS_AFS
    connect CPT_ECU_ABS_AFS.P_SPEED_TO_SENSOR_SPEED -> CPT_SENSOR_SPEED.R_SPEED_FROM_ECU_ABS_AFS
    connect CPT_ECU_ABS_AFS.P_STEERINGALGLE_TO_SENSOR_STERRINGANGLE -> CPT_SENSOR_STEERINGANGLE.R_STEERINGANGLE_FROM_ECU_ABS_AFS
    connect CPT_SENSOR_DISTANCE.P_DISTANCE_TO_APP_HIGHBEAM -> CPT_APP_HIGHBEAM.R_DISTANCE_FROM_SENSOR_DISTANCE
    connect CPT_SENSOR_LIGHT.P_LIGHT_TO_APP_LOWBEAM -> CPT_APP_LOWBEAM.R_LIGHT_FROM_SENSOR_LIGHT
    connect CPT_SENSOR_LIGHTMODE.P_LIGHTMODE_TO_APP_LOWBEAM -> CPT_APP_LOWBEAM.R_LIGHTMODE_FROM_SENSOR_LIGHTMODE
    connect CPT_SENSOR_LIGHTMODE.P_LIGHTMODE_TO_APP_HIGHBEAM -> CPT_APP_HIGHBEAM.R_LIGHTMODE_FROM_SENSOR_LIGHTMODE
    connect CPT_SENSOR_SPEED.P_SPEED_TO_APP_LOWBEAM -> CPT_APP_LOWBEAM.R_SPEED_FROM_SENSOR_SPEED
    connect CPT_SENSOR_STEERINGANGLE.P_STEERINGANGLE_TO_APP_MOTOR -> CPT_APP_MOTOR.R_STEERING_FROM_SENSOR_STEERINGANGLE
    connect CPT_SENSOR_SPEED.P_SPEED_TO_APP_MOTOR -> CPT_APP_MOTOR.R_SPEED_FROM_SENSOR_SPEED
    connect CPT_SENSOR_DISTANCE.P_DISTANCE_TO_APP_LOWBEAM -> CPT_APP_LOWBEAM.R_DISTANCE_FROM_SENSOR_DISTANCE
