AUTOSAR XML (schema 4-0-3)
package /RTE_CFG
  module config Rte_0: definition=Rte
    CPT_ECU_ABS_AFS (RteSwComponentInstance): RteSoftwareComponentInstanceRef=CPT_ECU_ABS_AFS
      6 x RteEventToTaskMapping, all with RtePositionInTask=1, RteActivationOffset=0.0:
        TE_ACTUATOR: RteMappedToTaskRef=TASK_ECU_ACTUATOR, RteEventRef=TE_ACTUATOR
        OIE_LIGHTMODE: RteMappedToTaskRef=TASK_ECU_LIGHTMODE, RteEventRef=OIE_LIGHTMODE
        OIE_LIGHT: RteMappedToTaskRef=TASK_ECU_LIGHT, RteEventRef=OIE_LIGHT
        OIE_DISTANCE: RteMappedToTaskRef=TASK_ECU_DISTANCE, RteEventRef=OIE_DISTANCE
        OIE_STEERINGANGLE: RteMappedToTaskRef=TASK_EUC_STEERINGANGLE, RteEventRef=OIE_STEERINGANGLE
        OIE_SPEED: RteMappedToTaskRef=TAKS_ECU_SPEED, RteEventRef=OIE_SPEED
    RteGeneration_0 (RteGeneration):
      RteGenerationMode = VENDOR_MODE
      RteCalibrationSupport = NONE
      RteDevErrorDetect = 0
      RteDevErrorDetectUninit = 0
      RteIocInteractionReturnValue = RTE_COM
      RteMeasurementSupport = 1
      RteOptimizationMode = RUNTIME
      RteToolChainSignificantCharacters = 127
      RteVfbTraceEnabled = 0
    12 x RteSwComponentInstance:
      CPT_SENSOR_DISTANCE: RteSoftwareComponentInstanceRef=CPT_SENSOR_DISTANCE
        TE_DISTANCE (RteEventToTaskMapping): RtePositionInTask=1, RteActivationOffset=0.0, RteMappedToTaskRef=TASK_SENSOR_DISTANCE, RteEventRef=TE_DISTANCE
      CPT_SENSOR_LIGHTMODE: RteSoftwareComponentInstanceRef=CPT_SENSOR_LIGHTMODE
        TE_LIGHTMODE (RteEventToTaskMapping): RtePositionInTask=1, RteActivationOffset=0.0, RteMappedToTaskRef=TASK_SENSOR_LIGHTMODE, RteEventRef=TE_LIGHTMODE
      CPT_SENSOR_STEERINGANGLE: RteSoftwareComponentInstanceRef=CPT_SENSOR_STEERINGANGLE
        TE_STEERINGANGLE (RteEventToTaskMapping): RtePositionInTask=1, RteActivationOffset=0.0, RteMappedToTaskRef=TASK_SENSOR_STEERINGANGLE, RteEventRef=TE_STEERINGANGLE
      CPT_SENSOR_LIGHT: RteSoftwareComponentInstanceRef=CPT_SENSOR_LIGHT
        TE_SENSOR (RteEventToTaskMapping): RtePositionInTask=1, RteActivationOffset=0.0, RteMappedToTaskRef=TASK_SENSOR_LIGHT, RteEventRef=TE_LIGHT
      CPT_SENSOR_SPEED: RteSoftwareComponentInstanceRef=CPT_SENSOR_SPEED
        TE_SPEED (RteEventToTaskMapping): RtePositionInTask=1, RteActivationOffset=0.0, RteMappedToTaskRef=TASK_SENSOR_SPEED, RteEventRef=TE_SPEED
      CPT_ACT_UPDOWN_MOTOR: RteSoftwareComponentInstanceRef=CPT_ACT_UPDOWN_MOTOR
        DRE_UPDOWNANGLE_RECEIVE (RteEventToTaskMapping): RtePositionInTask=1, RteActivationOffset=0.0, RteMappedToTaskRef=TASK_ACT_UPDOWNANGLE_RECEIVE, RteEventRef=DRE_UPDOWNANGLE_RECEIVE
        OIE_UPDOWNANGLE_SEND (RteEventToTaskMapping): RtePositionInTask=1, RteActivationOffset=0.0, RteMappedToTaskRef=TASK_ACT_UPDOWNANGLE_SEND, RteEventRef=OIE_UPDOWNANGLE_SEND
      CPT_ACT_LOWBEAM: RteSoftwareComponentInstanceRef=CPT_ACT_LOWBEAM
        DRE_LOWBEAM_RECEIVE (RteEventToTaskMapping): RtePositionInTask=1, RteActivationOffset=0.0, RteMappedToTaskRef=TASK_ACT_LOWBEAM_RECEIVE, RteEventRef=DRE_LOWBEAM_RECEIVE
        OIE_LOWBEAM_SEND (RteEventToTaskMapping): RtePositionInTask=1, RteActivationOffset=0.0, RteMappedToTaskRef=TASK_ACT_LOWBEAM_SEND, RteEventRef=OIE_LOWBEAM_SEND
      CPT_ACT_HIGHBEAM: RteSoftwareComponentInstanceRef=CPT_ACT_HIGHBEAM
        DRE_HIGHBEAM_RECEIVE (RteEventToTaskMapping): RtePositionInTask=1, RteActivationOffset=0.0, RteMappedToTaskRef=TASK_ACT_HIGHBEAM_RECEIVE, RteEventRef=DRE_HIGHBEAM_RECEIVE
        OIE_HIGHBEAM_SEND (RteEventToTaskMapping): RtePositionInTask=1, RteActivationOffset=0.0, RteMappedToTaskRef=TASK_ACT_HIGHBEAM_SEND, RteEventRef=OIE_HIGHBEAM_SEND
      CPT_ACT_LEFTRIGHT_MOTOR: RteSoftwareComponentInstanceRef=CPT_ACT_LEFTRIGHT_MOTOR
        DRE_LEFTRIGHTANGLE_RECEIVE (RteEventToTaskMapping): RtePositionInTask=1, RteActivationOffset=0.0, RteMappedToTaskRef=TASK_ACT_LEFTRIGHTANGLE_RECEIVE, RteEventRef=DRE_LEFTRIGHTANGLE_RECEIVE
        OIE_LEFTRIGHTANGLE_SEND (RteEventToTaskMapping): RtePositionInTask=1, RteActivationOffset=0.0, RteMappedToTaskRef=TASK_ACT_LEFTRIGHTANGLE_SEND, RteEventRef=OIE_LEFTRIGHTANGLE_SEND
      CPT_APP_MOTOR: RteSoftwareComponentInstanceRef=CPT_APP_MOTOR
        DRE_STEERING (RteEventToTaskMapping): RtePositionInTask=1, RteActivationOffset=0.0, RteMappedToTaskRef=TASK_APP_MOTOR, RteEventRef=DRE_STEERING
        DRE_SPEED (RteEventToTaskMapping): RtePositionInTask=2, RteActivationOffset=0.0, RteMappedToTaskRef=TASK_APP_MOTOR, RteEventRef=DRE_SPEED
      CPT_APP_LOWBEAM: RteSoftwareComponentInstanceRef=CPT_APP_LOWBEAM
        4 x RteEventToTaskMapping, all with RteActivationOffset=0.0, RteMappedToTaskRef=TASK_APP_LOWBEAM:
          DRE_LIGHT: RtePositionInTask=1, RteEventRef=DRE_LIGHT
          DRE_SPEED: RtePositionInTask=2, RteEventRef=DRE_SPEED
          DRE_LIGHTMODE: RtePositionInTask=4, RteEventRef=DRE_LIGHTMODE
          DataReceivedEvent_0: RtePositionInTask=3, RteEventRef=DRE_DISTANCE
      CPT_APP_HIGHBEAM: RteSoftwareComponentInstanceRef=CPT_APP_HIGHBEAM
        DRE_LIGHTMODE (RteEventToTaskMapping): RtePositionInTask=2, RteActivationOffset=0.0, RteMappedToTaskRef=TASK_APP_HIGHBEAM, RteEventRef=DRE_LIGHTMODE
        DRE_DISTANCE (RteEventToTaskMapping): RtePositionInTask=1, RteActivationOffset=0.0, RteMappedToTaskRef=TASK_APP_HIGHBEAM, RteEventRef=DRE_DISTANCE
