AUTOSAR XML (schema 4-0-3)
package /EcuInstance_0_FlatView
  flat map EcuInstance_0_FlatMap
    29 x flat instance descriptor:
      CPT_ACT_HIGHBEAM: upstream-reference=RootSwCompositionPrototype_0.CPT_ACT_HIGHBEAM, ecu-extract-reference=CPT_EcuInstance_0_FlatView.CPT_ACT_HIGHBEAM
      CPT_ACT_HIGHBEAM_IB_ACT_HIGHBEAM_Explicit_VariableDataPrototype_0: upstream-reference=RootSwCompositionPrototype_0.CPT_ACT_HIGHBEAM.Explicit_VariableDataPrototype_0, ecu-extract-reference=CPT_EcuInstance_0_FlatView.CPT_ACT_HIGHBEAM.Explicit_VariableDataPrototype_0
      CPT_ACT_LEFTRIGHT_MOTOR: upstream-reference=RootSwCompositionPrototype_0.CPT_ACT_LEFTRIGHT_MOTOR, ecu-extract-reference=CPT_EcuInstance_0_FlatView.CPT_ACT_LEFTRIGHT_MOTOR
      CPT_ACT_LEFTRIGHT_MOTOR_IB_ACT_LEFTRIGHT_MOTOR_Explicit_VariableDataPrototype_0: upstream-reference=RootSwCompositionPrototype_0.CPT_ACT_LEFTRIGHT_MOTOR.Explicit_VariableDataPrototype_0, ecu-extract-reference=CPT_EcuInstance_0_FlatView.CPT_ACT_LEFTRIGHT_MOTOR.Explicit_VariableDataPrototype_0
      CPT_ACT_LOWBEAM: upstream-reference=RootSwCompositionPrototype_0.CPT_ACT_LOWBEAM, ecu-extract-reference=CPT_EcuInstance_0_FlatView.CPT_ACT_LOWBEAM
      CPT_ACT_LOWBEAM_IB_ACT_LOWBEAM_Explicit_VariableDataPrototype_0: upstream-reference=RootSwCompositionPrototype_0.CPT_ACT_LOWBEAM.Explicit_VariableDataPrototype_0, ecu-extract-reference=CPT_EcuInstance_0_FlatView.CPT_ACT_LOWBEAM.Explicit_VariableDataPrototype_0
      CPT_ACT_UPDOWN_MOTOR: upstream-reference=RootSwCompositionPrototype_0.CPT_ACT_UPDOWN_MOTOR, ecu-extract-reference=CPT_EcuInstance_0_FlatView.CPT_ACT_UPDOWN_MOTOR
      CPT_ACT_UPDOWN_MOTOR_IB_ACT_UPDOWN_MOTOR_Explicit_VariableDataPrototype_0: upstream-reference=RootSwCompositionPrototype_0.CPT_ACT_UPDOWN_MOTOR.Explicit_VariableDataPrototype_0, ecu-extract-reference=CPT_EcuInstance_0_FlatView.CPT_ACT_UPDOWN_MOTOR.Explicit_VariableDataPrototype_0
      CPT_APP_HIGHBEAM: upstream-reference=RootSwCompositionPrototype_0.CPT_APP_HIGHBEAM, ecu-extract-reference=CPT_EcuInstance_0_FlatView.CPT_APP_HIGHBEAM
      VDP_APP_TO_ACT: upstream-reference=RootSwCompositionPrototype_0.CPT_APP_HIGHBEAM.P_HIGHBEAMMODE_TO_ACT_HIGHBEAM.VDP_APP_TO_ACT, ecu-extract-reference=CPT_EcuInstance_0_FlatView.CPT_APP_HIGHBEAM.P_HIGHBEAMMODE_TO_ACT_HIGHBEAM.VDP_APP_TO_ACT
      CPT_APP_LOWBEAM: upstream-reference=RootSwCompositionPrototype_0.CPT_APP_LOWBEAM, ecu-extract-reference=CPT_EcuInstance_0_FlatView.CPT_APP_LOWBEAM
      VDP_APP_TO_ACT_0: upstream-reference=RootSwCompositionPrototype_0.CPT_APP_LOWBEAM.P_LOWBEAMMODE_TO_ACT_LOWBEAM.VDP_APP_TO_ACT, ecu-extract-reference=CPT_EcuInstance_0_FlatView.CPT_APP_LOWBEAM.P_LOWBEAMMODE_TO_ACT_LOWBEAM.VDP_APP_TO_ACT
      CPT_APP_MOTOR: upstream-reference=RootSwCompositionPrototype_0.CPT_APP_MOTOR, ecu-extract-reference=CPT_EcuInstance_0_FlatView.CPT_APP_MOTOR
      VDP_APP_TO_ACT_1: upstream-reference=RootSwCompositionPrototype_0.CPT_APP_MOTOR.P_LEFTRIGHTANGLE_TO_ACT_LEFTRIGHT_MOTOR.VDP_APP_TO_ACT, ecu-extract-reference=CPT_EcuInstance_0_FlatView.CPT_APP_MOTOR.P_LEFTRIGHTANGLE_TO_ACT_LEFTRIGHT_MOTOR.VDP_APP_TO_ACT
      VDP_APP_TO_ACT_2: upstream-reference=RootSwCompositionPrototype_0.CPT_APP_MOTOR.P_UPDOWNANGLE_TO_ACT_UPDOWN_MOTOR.VDP_APP_TO_ACT, ecu-extract-reference=CPT_EcuInstance_0_FlatView.CPT_APP_MOTOR.P_UPDOWNANGLE_TO_ACT_UPDOWN_MOTOR.VDP_APP_TO_ACT
      CPT_ECU_ABS_AFS: upstream-reference=RootSwCompositionPrototype_0.CPT_ECU_ABS_AFS, ecu-extract-reference=CPT_EcuInstance_0_FlatView.CPT_ECU_ABS_AFS
      CPT_SENSOR_DISTANCE: upstream-reference=RootSwCompositionPrototype_0.CPT_SENSOR_DISTANCE, ecu-extract-reference=CPT_EcuInstance_0_FlatView.CPT_SENSOR_DISTANCE
      VDP_SENSOR_TO_APP: upstream-reference=RootSwCompositionPrototype_0.CPT_SENSOR_DISTANCE.P_DISTANCE_TO_APP_HIGHBEAM.VDP_SENSOR_TO_APP, ecu-extract-reference=CPT_EcuInstance_0_FlatView.CPT_SENSOR_DISTANCE.P_DISTANCE_TO_APP_HIGHBEAM.VDP_SENSOR_TO_APP
      VDP_SENSOR_TO_APP_0: upstream-reference=RootSwCompositionPrototype_0.CPT_SENSOR_DISTANCE.P_DISTANCE_TO_APP_LOWBEAM.VDP_SENSOR_TO_APP, ecu-extract-reference=CPT_EcuInstance_0_FlatView.CPT_SENSOR_DISTANCE.P_DISTANCE_TO_APP_LOWBEAM.VDP_SENSOR_TO_APP
      CPT_SENSOR_LIGHT: upstream-reference=RootSwCompositionPrototype_0.CPT_SENSOR_LIGHT, ecu-extract-reference=CPT_EcuInstance_0_FlatView.CPT_SENSOR_LIGHT
      VDP_SENSOR_TO_APP_1: upstream-reference=RootSwCompositionPrototype_0.CPT_SENSOR_LIGHT.P_LIGHT_TO_APP_LOWBEAM.VDP_SENSOR_TO_APP, ecu-extract-reference=CPT_EcuInstance_0_FlatView.CPT_SENSOR_LIGHT.P_LIGHT_TO_APP_LOWBEAM.VDP_SENSOR_TO_APP
      CPT_SENSOR_LIGHTMODE: upstream-reference=RootSwCompositionPrototype_0.CPT_SENSOR_LIGHTMODE, ecu-extract-reference=CPT_EcuInstance_0_FlatView.CPT_SENSOR_LIGHTMODE
      VDP_SENSOR_TO_APP_2: upstream-reference=RootSwCompositionPrototype_0.CPT_SENSOR_LIGHTMODE.P_LIGHTMODE_TO_APP_HIGHBEAM.VDP_SENSOR_TO_APP, ecu-extract-reference=CPT_EcuInstance_0_FlatView.CPT_SENSOR_LIGHTMODE.P_LIGHTMODE_TO_APP_HIGHBEAM.VDP_SENSOR_TO_APP
      VDP_SENSOR_TO_APP_3: upstream-reference=RootSwCompositionPrototype_0.CPT_SENSOR_LIGHTMODE.P_LIGHTMODE_TO_APP_LOWBEAM.VDP_SENSOR_TO_APP, ecu-extract-reference=CPT_EcuInstance_0_FlatView.CPT_SENSOR_LIGHTMODE.P_LIGHTMODE_TO_APP_LOWBEAM.VDP_SENSOR_TO_APP
      CPT_SENSOR_SPEED: upstream-reference=RootSwCompositionPrototype_0.CPT_SENSOR_SPEED, ecu-extract-reference=CPT_EcuInstance_0_FlatView.CPT_SENSOR_SPEED
      VDP_SENSOR_TO_APP_4: upstream-reference=RootSwCompositionPrototype_0.CPT_SENSOR_SPEED.P_SPEED_TO_APP_LOWBEAM.VDP_SENSOR_TO_APP, ecu-extract-reference=CPT_EcuInstance_0_FlatView.CPT_SENSOR_SPEED.P_SPEED_TO_APP_LOWBEAM.VDP_SENSOR_TO_APP
      VDP_SENSOR_TO_APP_5: upstream-reference=RootSwCompositionPrototype_0.CPT_SENSOR_SPEED.P_SPEED_TO_APP_MOTOR.VDP_SENSOR_TO_APP, ecu-extract-reference=CPT_EcuInstance_0_FlatView.CPT_SENSOR_SPEED.P_SPEED_TO_APP_MOTOR.VDP_SENSOR_TO_APP
      CPT_SENSOR_STEERINGANGLE: upstream-reference=RootSwCompositionPrototype_0.CPT_SENSOR_STEERINGANGLE, ecu-extract-reference=CPT_EcuInstance_0_FlatView.CPT_SENSOR_STEERINGANGLE
      VDP_SENSOR_TO_APP_6: upstream-reference=RootSwCompositionPrototype_0.CPT_SENSOR_STEERINGANGLE.P_STEERINGANGLE_TO_APP_MOTOR.VDP_SENSOR_TO_APP, ecu-extract-reference=CPT_EcuInstance_0_FlatView.CPT_SENSOR_STEERINGANGLE.P_STEERINGANGLE_TO_APP_MOTOR.VDP_SENSOR_TO_APP
