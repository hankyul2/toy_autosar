AUTOSAR XML (schema 4-0-3)
package /OS_CFG
  module config Os_0: definition=Os
    22 x OsTask, all with OsTaskActivation=1:
      TASK_ECU_ACTUATOR: OsTaskPriority=1
      TASK_SENSOR_DISTANCE: OsTaskPriority=2
      TASK_SENSOR_LIGHTMODE: OsTaskPriority=2
      TASK_SENSOR_STEERINGANGLE: OsTaskPriority=2
      TASK_SENSOR_LIGHT: OsTaskPriority=2
      TASK_SENSOR_SPEED: OsTaskPriority=2
      TASK_ACT_UPDOWNANGLE_RECEIVE: OsTaskPriority=2
      TASK_ACT_LOWBEAM_RECEIVE: OsTaskPriority=2
      TASK_ACT_HIGHBEAM_RECEIVE: OsTaskPriority=2
      TASK_ACT_LEFTRIGHTANGLE_RECEIVE: OsTaskPriority=2
      TASK_ACT_LEFTRIGHTANGLE_SEND: OsTaskPriority=2
      TASK_ACT_HIGHBEAM_SEND: OsTaskPriority=2
      TASK_ACT_UPDOWNANGLE_SEND: OsTaskPriority=2
      TASK_ACT_LOWBEAM_SEND: OsTaskPriority=2
      TASK_ECU_LIGHTMODE: OsTaskPriority=1
      TASK_ECU_LIGHT: OsTaskPriority=1
      TASK_ECU_DISTANCE: OsTaskPriority=1
      TASK_EUC_STEERINGANGLE: OsTaskPriority=1
      TAKS_ECU_SPEED: OsTaskPriority=1
      TASK_APP_MOTOR: OsTaskPriority=3
      TASK_APP_LOWBEAM: OsTaskPriority=3
      TASK_APP_HIGHBEAM: OsTaskPriority=3
