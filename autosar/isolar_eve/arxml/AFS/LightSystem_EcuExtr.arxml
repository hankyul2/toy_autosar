AUTOSAR XML (schema 4-0-3)
package /LightSystem_EcuExtract
  system EXTR_EcuInstance_0: category=ECU_EXTRACT
    system mapping SYSMPG_EcuInstance_0
      sw-mappings:
        swc to ecu mapping SwcToEcuMapping_0: ecu-instance=EcuInstance_0
          component:
            CPT_EcuInstance_0_FlatView.CPT_ACT_HIGHBEAM
            CPT_EcuInstance_0_FlatView.CPT_ACT_LEFTRIGHT_MOTOR
            CPT_EcuInstance_0_FlatView.CPT_ACT_LOWBEAM
            CPT_EcuInstance_0_FlatView.CPT_ACT_UPDOWN_MOTOR
            CPT_EcuInstance_0_FlatView.CPT_APP_HIGHBEAM
            CPT_EcuInstance_0_FlatView.CPT_APP_LOWBEAM
            CPT_EcuInstance_0_FlatView.CPT_APP_MOTOR
            CPT_EcuInstance_0_FlatView.CPT_ECU_ABS_AFS
            CPT_EcuInstance_0_FlatView.CPT_SENSOR_DISTANCE
            CPT_EcuInstance_0_FlatView.CPT_SENSOR_LIGHT
            CPT_EcuInstance_0_FlatView.CPT_SENSOR_LIGHTMODE
            CPT_EcuInstance_0_FlatView.CPT_SENSOR_SPEED
            CPT_EcuInstance_0_FlatView.CPT_SENSOR_STEERINGANGLE
    root-software-compositions:
      root sw composition prototype CPT_EcuInstance_0_FlatView: flat-map=EcuInstance_0_FlatMap, software-composition=EcuInstance_0_FlatView
